## CMakeLists.txt
```
cmake_minimum_required(VERSION 3.20.0)
list(APPEND BOARD_ROOT ${CMAKE_CURRENT_SOURCE_DIR})
list(APPEND DTS_ROOT ${CMAKE_CURRENT_SOURCE_DIR})
find_package(Zephyr REQUIRED HINTS $ENV{ZEPHYR_BASE})
project(sentiframe C)
target_include_directories(app PRIVATE include third_party/bmi270)
target_sources(app PRIVATE
    src/main.c src/platform.c src/transport.c
    src/core/protocol.c src/core/fall.c src/core/rx.c
    src/drivers/charger.c src/drivers/ppg.c src/drivers/imu.c
    third_party/bmi270/bmi2.c third_party/bmi270/bmi270.c)
target_compile_options(app PRIVATE -Wall -Wextra -Werror)
```

## Kconfig
```
mainmenu "SentiFrame firmware"
source "Kconfig.zephyr"

menu "SentiFrame application"
config SF_CHARGING
    bool "Request charging (also requires a physically approved pack)"
    default n
    help
      False keeps the hardware charge gate low. Safe charger/SYS-path
      configuration and source monitoring remain active in either state.
config SF_IMU
    bool "Enable IMU acquisition and fall detection"
    default y
    help
      False shuts down retained BMI270 sensor state at boot, then disables
      acquisition, recovery and its wake interrupt. SOS remains available.
config SF_PACK_APPROVED
    bool "Enable charging for a physically qualified battery pack"
    default n
    help
      Keep disabled until the exact protected 1S pack and NTC assembly have
      been qualified for 4.20V / 30mA fast charge, 6mA precharge / 3mA
      termination, recovery at >=2.30V, and the actual NTC thresholds and
      hysteresis (nominal COLD=5C, COOL=10C, HOT=45C; COOL also inhibits).
      This is a build-time setting; no received packet can override it.
config SF_GYRO
    bool "Continuously acquire the gyroscope alongside 100Hz acceleration"
    depends on SF_IMU
    default n
    help
      Default off to reduce current. Raw packets explicitly flag whether
      gyroscope samples are valid. Rebuild with this enabled for six-axis tests.
config SF_PPG
    bool "Enable green-channel raw PPG acquisition"
    default y
config SF_STREAM_DIVISOR
    int "IMU raw telemetry decimation (100Hz / value)"
    range 1 10
    default 2
    help
      The fall detector and local history always consume every 100Hz sample.
      Only continuous telemetry is decimated; event history is preserved.
endmenu
```

## prj.conf
```kconfig
CONFIG_GPIO=y
CONFIG_PINCTRL=y
CONFIG_PM_DEVICE=y
CONFIG_I2C=y
CONFIG_I2C_NRFX_TRANSFER_TIMEOUT=100
CONFIG_SERIAL=y
CONFIG_UART_INTERRUPT_DRIVEN=y
CONFIG_CONSOLE=n
CONFIG_UART_CONSOLE=n
CONFIG_ADC=y
CONFIG_WATCHDOG=y
CONFIG_HWINFO=y
CONFIG_FPU=y
CONFIG_NEWLIB_LIBC=y
CONFIG_MAIN_STACK_SIZE=8192
CONFIG_SYSTEM_WORKQUEUE_STACK_SIZE=2048
CONFIG_HEAP_MEM_POOL_SIZE=4096
CONFIG_BT=y
CONFIG_BT_PERIPHERAL=y
CONFIG_BT_DEVICE_NAME="SentiFrame"
CONFIG_BT_MAX_CONN=1
CONFIG_BT_SMP=y
CONFIG_BT_BONDABLE=y
CONFIG_BT_SETTINGS=y
CONFIG_SETTINGS=y
CONFIG_FLASH=y
CONFIG_FLASH_MAP=y
CONFIG_USE_DT_CODE_PARTITION=y
CONFIG_NVS=y
CONFIG_SETTINGS_NVS=y
CONFIG_BT_ATT_TX_COUNT=12
CONFIG_BT_L2CAP_TX_BUF_COUNT=12
CONFIG_BT_BUF_ACL_TX_COUNT=12
CONFIG_BT_BUF_EVT_RX_COUNT=16
CONFIG_BT_BUF_ACL_TX_SIZE=128
CONFIG_BT_BUF_ACL_RX_SIZE=128
CONFIG_BT_L2CAP_TX_MTU=124
CONFIG_BT_PERIPHERAL_PREF_MIN_INT=12
CONFIG_BT_PERIPHERAL_PREF_MAX_INT=24
CONFIG_BT_PERIPHERAL_PREF_TIMEOUT=400
CONFIG_CLOCK_CONTROL_NRF_K32SRC_RC=y
CONFIG_CLOCK_CONTROL_NRF_K32SRC_XTAL=n
CONFIG_CLOCK_CONTROL_NRF_K32SRC_RC_CALIBRATION=y
CONFIG_CLOCK_CONTROL_NRF_K32SRC_500PPM=y
CONFIG_LOG=y
CONFIG_USE_SEGGER_RTT=y
CONFIG_LOG_BACKEND_RTT=y
CONFIG_LOG_BACKEND_UART=n
CONFIG_LOG_DEFAULT_LEVEL=3
CONFIG_SF_PACK_APPROVED=n
```

## dts/bindings/sentiframe,control.yaml
```yaml
description: SentiFrame Rev F GPIO controls and gated battery measurement
compatible: "sentiframe,control"
include: base.yaml
properties:
  charge-arm-gpios: {type: phandle-array, required: true}
  ppg-enable-gpios: {type: phandle-array, required: true}
  led-gpios: {type: phandle-array, required: true}
  motor-gpios: {type: phandle-array, required: true}
  battery-enable-gpios: {type: phandle-array, required: true}
  uart-enable-gpios: {type: phandle-array, required: true}
  usb-pg-gpios: {type: phandle-array, required: true}
  suspend-gpios: {type: phandle-array, required: true}
  imu-int-gpios: {type: phandle-array, required: true}
  ppg-int-gpios: {type: phandle-array, required: true}
  button-gpios: {type: phandle-array, required: true}
  bc-open-gpios: {type: phandle-array, required: true}
  bc-allow-gpios: {type: phandle-array, required: true}
  bc-high-gpios: {type: phandle-array, required: true}
  chg-int-gpios: {type: phandle-array, required: true}
  io-channels: {type: phandle-array, required: true}
```

## src/main.c
```c
/* SPDX-License-Identifier: MIT */
#include "sf_platform.h"
#include "sf_imu.h"
#include <zephyr/random/random.h>
#include <zephyr/logging/log.h>
#include <errno.h>
#include <math.h>
#include <string.h>
LOG_MODULE_REGISTER(sentiframe,LOG_LEVEL_INF);

static struct sf_bus bus;
static struct sf_charger charger;
static struct sf_imu imu;
static struct sf_fall fall;
static struct sf_link link;
static struct sf_reliable reliable;
static struct sf_parser usb_parser, ble_parser;
static struct sf_power_input power;
static uint32_t sequence, sensor_errors, context_overflows;
static bool imu_ok, ppg_ok, physical_usb_ready, imu_shutdown_failed;
static bool ppg_failed, ppg_needs_off;
static uint32_t led_until, usb_since;
static struct sf_sample snapshot[SF_HISTORY_SIZE];
static size_t snapshot_count, snapshot_offset;
static uint32_t snapshot_event, snapshot_started, history_try;
static struct sf_packet history_packet;
static bool history_waiting, history_sent;

static struct sf_packet packet(uint8_t type, uint32_t now) {
    return (struct sf_packet){.type=type,.seq=++sequence,.time_ms=now,.boot=link.boot};
}
static enum sf_transport route(uint32_t now) {
    return sf_link_select(&link,now,physical_usb_ready,sf_ble_ready());
}
static void hello(enum sf_transport dst, uint32_t now) {
    struct sf_packet p=packet(SF_HELLO,now);
    p.length=6; p.payload[0]=1; p.payload[1]=6; /* protocol 1, hardware Rev F */
    p.payload[2]=0; p.payload[3]=2; p.payload[4]=1; /* firmware 0.2.1 */
    p.payload[5]=(IS_ENABLED(CONFIG_SF_GYRO)?1:0)|(IS_ENABLED(CONFIG_SF_PPG)?2:0)|
                 (IS_ENABLED(CONFIG_SF_PACK_APPROVED)?4:0)|
                 (IS_ENABLED(CONFIG_SF_IMU)?8:0)|(IS_ENABLED(CONFIG_SF_CHARGING)?16:0);
    (void)sf_transport_send(dst,&p);
}
static void queue_event(enum sf_event kind, uint8_t detail, uint32_t now) {
    bool capture=kind==SF_IMPACT||kind==SF_SOS;
    bool busy=capture&&snapshot_count;
    struct sf_packet p=packet(SF_EVENT,now);
    p.length=12; p.payload[0]=(uint8_t)kind; p.payload[1]=detail;
    sf_put16(p.payload+2,busy?SF_DATA_GAP:0);
    sf_put16(p.payload+4,power.battery_mv<0?UINT16_MAX:(uint16_t)power.battery_mv);
    sf_put16(p.payload+6,(uint16_t)fminf(fall.peak_g*1000.0f,65535.0f));
    int16_t z=(int16_t)(fminf(fmaxf(fall.last_z,-327.68f),327.67f)*100.0f);
    sf_put16(p.payload+8,(uint16_t)z);
    sf_put16(p.payload+10,capture&&!busy?(uint16_t)fall.count:0);
    if (!sf_reliable_add(&reliable,&p)) { LOG_ERR("Event queue full"); return; }
    if (busy) context_overflows++;
    if (capture&&!busy) {
        snapshot_count=sf_fall_history(&fall,snapshot,ARRAY_SIZE(snapshot));
        snapshot_offset=0; snapshot_event=p.seq; snapshot_started=now;
        history_waiting=false; history_sent=false;
    }
    if (kind!=SF_SENSOR_FAULT) led_until=now+500;
}
static void ppg_fault(uint32_t now) {
    if (ppg_failed) return;
    ppg_failed=true; sensor_errors++;
    queue_event(SF_SENSOR_FAULT,3,now);
}
static void ppg_stop(uint32_t now) {
    int err=sf_ppg_power(false);
    ppg_ok=false;
    /* If GPIO failed, keep trying to revoke the rail, and report uncertainty. */
    ppg_needs_off=err!=0;
    if (err) ppg_fault(now);
}
static void history_send(uint32_t now) {
    if (!snapshot_count) return;
    if ((uint32_t)(now-snapshot_started)>60000) {
        snapshot_count=0; history_waiting=false; context_overflows++; return;
    }
    enum sf_transport dst=route(now);
    if (dst==SF_NO_LINK) return;
    if (!history_waiting) {
        history_packet=packet(SF_HISTORY,now);
        size_t n=snapshot_count-snapshot_offset; if (n>4) n=4;
        sf_put32(history_packet.payload,snapshot_event);
        sf_put16(history_packet.payload+4,(uint16_t)snapshot_count);
        sf_put16(history_packet.payload+6,(uint16_t)snapshot_offset);
        history_packet.payload[8]=(uint8_t)n;
        for (size_t i=0;i<n;i++) {
            const struct sf_sample *s=snapshot+snapshot_offset+i;
            uint8_t *b=history_packet.payload+9+i*18;
            sf_put32(b,s->time_ms);
            for (unsigned j=0;j<3;j++) { sf_put16(b+4+2*j,(uint16_t)s->a[j]); sf_put16(b+10+2*j,(uint16_t)s->g[j]); }
            sf_put16(b+16,s->flags);
        }
        history_packet.length=(uint16_t)(9+n*18); history_waiting=true; history_sent=false;
    }
    if (!history_sent||(uint32_t)(now-history_try)>=SF_RETRY_MS) {
        if (!sf_transport_send(dst,&history_packet)) { history_sent=true; history_try=now; }
    }
}
static void consume(const struct sf_packet *p, enum sf_transport src, uint32_t now) {
    if (src==SF_USB&&!physical_usb_ready) return;
    if (src==SF_BLE&&!sf_ble_ready()) return;
    if (p->type==SF_HELLO&&p->length==0&&(p->boot==0||p->boot==link.boot)) {
        if (src==SF_USB&&!sf_link_hello(&link,p,physical_usb_ready)) return;
        hello(src,now); return;
    }
    if (p->boot!=link.boot) return;
    if (p->type==SF_HEARTBEAT&&p->length==0) {
        if (src==SF_USB) (void)sf_link_heartbeat(&link,p,now,physical_usb_ready);
        struct sf_packet response=packet(SF_HEARTBEAT,now);
        (void)sf_transport_send(src,&response);
    } else if (p->type==SF_ACK&&p->length==4) {
        uint32_t seq=sf_get32(p->payload);
        (void)sf_reliable_ack(&reliable,p->boot,seq);
        if (history_waiting&&seq==history_packet.seq) {
            snapshot_offset+=history_packet.payload[8]; history_waiting=false;
            if (snapshot_offset==snapshot_count) snapshot_count=0;
        }
    }
    /* Received packets cannot change charge limits, disable TS, drive the
     * motor, or mark an unknown battery as approved. */
}
static void receive(uint32_t now) {
    struct sf_rx_chunk c;
    for (unsigned n=0;n<24&&sf_rx_pop(&c);n++) {
        struct sf_parser *parser=c.transport==SF_USB?&usb_parser:&ble_parser;
        if (c.gap) memset(parser,0,sizeof(*parser));
        if (c.transport==SF_USB&&!physical_usb_ready) { memset(parser,0,sizeof(*parser)); continue; }
        for (size_t i=0;i<c.length;i++) {
            struct sf_packet p;
            if (sf_parser_push(parser,c.bytes[i],&p)) consume(&p,c.transport,now);
        }
    }
}
static void raw_imu(const struct sf_sample *s) {
    struct sf_packet p=packet(SF_IMU,s->time_ms); p.length=14;
    for (unsigned i=0;i<3;i++) { sf_put16(p.payload+2*i,(uint16_t)s->a[i]); sf_put16(p.payload+6+2*i,(uint16_t)s->g[i]); }
    sf_put16(p.payload+12,s->flags);
    enum sf_transport dst=route(k_uptime_get_32());
    if (dst!=SF_NO_LINK) (void)sf_transport_send(dst,&p);
}
static void status(uint32_t now) {
    struct sf_packet p=packet(SF_STATUS,now); p.length=30;
    sf_put16(p.payload,power.battery_mv<0?UINT16_MAX:(uint16_t)power.battery_mv);
    p.payload[2]=(uint8_t)sf_classify_source(&power);
    p.payload[3]=(charger.enabled?1:0)|(charger.fault?2:0)|(imu_ok?4:0)|(ppg_ok?8:0)|
        (IS_ENABLED(CONFIG_SF_GYRO)?16:0)|(power.pack_approved?32:0)|
        (physical_usb_ready?64:0)|(power.usb_alive?128:0);
    p.payload[4]=charger.stat0; p.payload[5]=charger.stat1;
    p.payload[6]=(uint8_t)route(now); p.payload[7]=(uint8_t)reliable.count;
    sf_put32(p.payload+8,sensor_errors); sf_put32(p.payload+12,sf_tx_drops());
    sf_put32(p.payload+16,sf_rx_drops()); sf_put32(p.payload+20,reliable.overflow);
    sf_put32(p.payload+24,context_overflows); sf_put16(p.payload+28,CONFIG_SF_STREAM_DIVISOR);
    enum sf_transport dst=route(now);
    if (dst!=SF_NO_LINK) (void)sf_transport_send(dst,&p);
}
int main(void) {
    int err=sf_board_init(&bus);
    if (err) { LOG_ERR("GPIO/bus init failed: %d",err); return err; }
    err=sf_watchdog_start();
    if (err) { sf_charge_gate(NULL,false); LOG_ERR("Watchdog unavailable: %d",err); return err; }
    link.boot=sys_rand32_get(); if (!link.boot) link.boot=1;
    power.pack_approved=IS_ENABLED(CONFIG_SF_PACK_APPROVED);
    power.charging_requested=IS_ENABLED(CONFIG_SF_CHARGING); power.battery_mv=-1;
    err=sf_charger_init(&charger,&bus,sf_charge_gate,NULL);
    if (err) { sensor_errors++; LOG_ERR("Charge locked off: %d",err); }
    err=sf_transport_init();
    if (err) { sf_charge_gate(NULL,false); LOG_ERR("Transport init failed: %d",err); return err; }
    if (IS_ENABLED(CONFIG_SF_IMU)) {
        imu_ok=sf_imu_init(&imu,&bus,IS_ENABLED(CONFIG_SF_GYRO))==0;
    } else {
        /* MCU reset does not reset the separately powered BMI270. */
        imu_shutdown_failed=sf_imu_shutdown(&bus)!=0;
    }
    if ((IS_ENABLED(CONFIG_SF_IMU)&&!imu_ok)||imu_shutdown_failed) {
        sensor_errors++; queue_event(SF_SENSOR_FAULT,2,k_uptime_get_32());
    }
    uint32_t last_power=k_uptime_get_32()-250, last_battery=k_uptime_get_32()-10000;
    uint32_t last_imu=0,last_ppg=0,last_status=0,last_retry=k_uptime_get_32();
    usb_since=k_uptime_get_32();
    bool button_raw=false,button_stable=false,charger_reported=false;
    uint32_t button_changed=0,telemetry_count=0;
    while (true) {
        uint32_t now=k_uptime_get_32();
        if (sf_take_power_change()) {
            struct sf_power_input revoked=power; revoked.present=false;
            (void)sf_charger_step(&charger,&revoked,now);
            link.usb_seen=false; physical_usb_ready=false; usb_since=now;
            sf_rx_reset(SF_USB);
            memset(&usb_parser,0,sizeof(usb_parser)); last_power=now-250;
        }
        if ((uint32_t)(now-last_battery)>=10000) { power.battery_mv=sf_battery_mv(); last_battery=now; }
        if ((uint32_t)(now-last_power)>=250) {
            bool was_present=power.present;
            int pin_err=sf_read_inputs(&power);
            if (!was_present&&power.present) usb_since=now;
            if (pin_err) sensor_errors++;
            power.cc_valid=false;
            if (power.present&&!pin_err&&sf_cc_read(&bus,&power)) sensor_errors++;
            physical_usb_ready=power.present&&power.awake&&!power.switch_open&&power.allow&&
                               (uint32_t)(now-usb_since)>=1000;
            if (sf_uart_enable(physical_usb_ready)) {
                physical_usb_ready=false; sf_charge_gate(NULL,false);
                charger.fault=true; sensor_errors++;
            }
            power.usb_alive=sf_link_select(&link,now,physical_usb_ready,false)==SF_USB;
            err=sf_charger_step(&charger,&power,now);
            if (err&&!charger_reported) { charger_reported=true; queue_event(SF_SENSOR_FAULT,7,now); }
            last_power=now;
        }
        receive(now);
        int pressed=sf_button_pressed();
        if (pressed>=0&&(pressed!=0)!=button_raw) { button_raw=pressed!=0; button_changed=now; }
        if (button_raw!=button_stable&&(uint32_t)(now-button_changed)>=30) {
            button_stable=button_raw; if (button_stable) queue_event(SF_SOS,0,now);
        }
        if (IS_ENABLED(CONFIG_SF_IMU)&&imu_ok&&(uint32_t)(now-last_imu)>=20) {
            struct sf_sample samples[64]; size_t n=0;
            err=sf_imu_read(&imu,samples,ARRAY_SIZE(samples),&n,now);
            if (err) {
                sensor_errors++; sf_fall_reset(&fall); queue_event(SF_SENSOR_FAULT,2,now);
                if (err!=-EOVERFLOW) imu_ok=false;
            } else for (size_t i=0;i<n;i++) {
                enum sf_event e=sf_fall_push(&fall,samples+i);
                if (e) queue_event(e,0,samples[i].time_ms);
                if ((telemetry_count++%CONFIG_SF_STREAM_DIVISOR)==0) raw_imu(samples+i);
            }
            last_imu=now;
        }
        if (IS_ENABLED(CONFIG_SF_IMU)&&!imu_ok&&(uint32_t)(now-last_retry)>=5000) {
            /* Retrying a full config image can take ~1s. Keep charging disabled
             * during a recovery and latch the charger fault until reset. */
            sf_charge_gate(NULL,false); charger.fault=true;
            imu_ok=sf_imu_init(&imu,&bus,IS_ENABLED(CONFIG_SF_GYRO))==0;
            sf_fall_reset(&fall); last_retry=k_uptime_get_32();
        }
        if (!IS_ENABLED(CONFIG_SF_IMU)&&imu_shutdown_failed&&
            (uint32_t)(now-last_retry)>=5000) {
            /* A transient bus fault must not leave an old measurement running.
             * This retries only shutdown, never the configuration upload. */
            imu_shutdown_failed=sf_imu_shutdown(&bus)!=0;
            last_retry=k_uptime_get_32();
        }
        bool want_ppg=IS_ENABLED(CONFIG_SF_PPG)&&(power.present||power.battery_mv>=3300);
        if ((!want_ppg&&ppg_ok)||ppg_needs_off) ppg_stop(now);
        if (want_ppg&&!ppg_ok&&!ppg_failed&&!ppg_needs_off) {
            err=sf_ppg_power(true);
            if (!err) { k_msleep(20); err=sf_ppg_init(&bus); }
            if (err) {
                ppg_fault(now); ppg_stop(now);
            } else ppg_ok=true;
        }
        if (IS_ENABLED(CONFIG_SF_PPG)&&ppg_ok&&(uint32_t)(now-last_ppg)>=100) {
            struct sf_ppg_word words[32]; size_t n=0; bool gap=false;
            err=sf_ppg_read(&bus,words,ARRAY_SIZE(words),&n,&gap);
            if (err) {
                ppg_fault(now); ppg_stop(now);
            } else for (size_t i=0;i<n;i++) {
                struct sf_packet p=packet(SF_PPG,now-(uint32_t)(n-1-i)*20u);
                p.length=6; sf_put32(p.payload,words[i].value); p.payload[4]=words[i].tag;
                p.payload[5]=SF_TIME_ESTIMATED|(words[i].saturated?SF_SATURATED:0)|(gap?SF_DATA_GAP:0);
                enum sf_transport dst=route(now);
                if (dst!=SF_NO_LINK) (void)sf_transport_send(dst,&p);
            }
            if (gap) sensor_errors++;
            last_ppg=now;
        }
        enum sf_transport dst=route(now);
        if (dst!=SF_NO_LINK) {
            const struct sf_packet *p=sf_reliable_due(&reliable,now);
            if (p) (void)sf_transport_send(dst,p);
        }
        history_send(now);
        if ((uint32_t)(now-last_status)>=2000) { status(now); last_status=now; }
        bool alarm=(int32_t)(led_until-now)>0;
        bool fault=charger.fault||(IS_ENABLED(CONFIG_SF_IMU)&&!imu_ok)||
            imu_shutdown_failed||ppg_failed||reliable.overflow||context_overflows;
        sf_led(alarm||(fault&&now%2000<80));
        if (sf_watchdog_feed()) { sf_charge_gate(NULL,false); return -EIO; }
        /* System ON idle preserves the FIFO and BLE link; no busy-poll loop. */
        (void)k_sem_take(&sf_wake,K_MSEC(20));
    }
}
```

## include/sf_core.h
```c
/* SPDX-License-Identifier: MIT */
#ifndef SF_CORE_H
#define SF_CORE_H
#include <stdbool.h>
#include <stddef.h>
#include <stdint.h>

#define SF_PAYLOAD_MAX 96u
#define SF_HEADER_SIZE 18u
#define SF_FRAME_MAX (SF_HEADER_SIZE + SF_PAYLOAD_MAX + 2u)
#define SF_HISTORY_SIZE 200u
#define SF_PENDING_MAX 8u
#define SF_USB_LEASE_MS 1500u
#define SF_RETRY_MS 1000u

enum sf_type { SF_HELLO=1, SF_HEARTBEAT=2, SF_ACK=3,
               SF_IMU=16, SF_PPG=17, SF_STATUS=18, SF_EVENT=19,
               SF_HISTORY=20 };
enum sf_event { SF_IMPACT=1, SF_FALL_SUSPECTED=2, SF_SOS=3, SF_SENSOR_FAULT=4 };
enum sf_transport { SF_NO_LINK, SF_USB, SF_BLE };
enum sf_flags { SF_GYRO_VALID=1, SF_SATURATED=2, SF_TIME_ESTIMATED=4,
                SF_DATA_GAP=8 };
struct sf_packet {
    uint8_t type;
    uint16_t length;
    uint32_t seq, time_ms, boot;
    uint8_t payload[SF_PAYLOAD_MAX];
};
struct sf_parser { uint8_t bytes[SF_FRAME_MAX]; size_t used; uint32_t rejected; };
uint16_t sf_crc16(const uint8_t *data, size_t len);
size_t sf_encode(const struct sf_packet *p, uint8_t *out, size_t cap);
bool sf_parser_push(struct sf_parser *p, uint8_t byte, struct sf_packet *out);
void sf_put16(uint8_t *out, uint16_t x);
void sf_put32(uint8_t *out, uint32_t x);
uint16_t sf_get16(const uint8_t *in);
uint32_t sf_get32(const uint8_t *in);

struct sf_link {
    uint32_t boot, usb_time, usb_seq;
    bool usb_seen;
};
bool sf_link_heartbeat(struct sf_link *l, const struct sf_packet *p,
                       uint32_t now, bool physical_usb_ready);
bool sf_link_hello(struct sf_link *l, const struct sf_packet *p, bool physical_usb_ready);
enum sf_transport sf_link_select(const struct sf_link *l, uint32_t now,
                                 bool physical_usb_ready, bool ble_ready);
struct sf_pending { struct sf_packet packet; uint32_t last_try; bool sent; };
struct sf_reliable {
    struct sf_pending items[SF_PENDING_MAX];
    size_t count;
    uint32_t overflow;
};
bool sf_reliable_add(struct sf_reliable *q, const struct sf_packet *p);
const struct sf_packet *sf_reliable_due(struct sf_reliable *q, uint32_t now);
bool sf_reliable_ack(struct sf_reliable *q, uint32_t boot, uint32_t seq);

struct sf_bus {
    void *ctx;
    int (*read)(void *, uint8_t addr, uint8_t reg, uint8_t *buf, size_t len);
    int (*write)(void *, uint8_t addr, uint8_t reg, const uint8_t *buf, size_t len);
    void (*delay_ms)(void *, uint32_t ms);
};
enum sf_source { SF_SRC_NONE, SF_SRC_UNKNOWN, SF_SRC_SDP, SF_SRC_CDP,
                 SF_SRC_DCP, SF_SRC_TYPEC_1A5, SF_SRC_TYPEC_3A };
struct sf_power_input {
    bool present, awake, allow, high, switch_open;
    bool cc_valid, pack_approved, usb_alive;
    bool charging_requested; /* Independent feature switch; zero is fail-closed. */
    uint8_t cc_attached, cc_current, cc_accessory;
    int32_t battery_mv; /* -1 means ADC failure, never a fake zero-percent */
};
struct sf_charger {
    struct sf_bus bus;
    void (*gate)(void *, bool);
    void *gate_ctx;
    bool initialized, enabled, fault;
    enum sf_source stable_source;
    uint32_t stable_since;
    unsigned stable_count;
    uint8_t stat0, stat1, flags;
};
enum sf_source sf_classify_source(const struct sf_power_input *in);
int sf_charger_init(struct sf_charger *c, const struct sf_bus *bus,
                    void (*gate)(void *, bool), void *ctx);
int sf_charger_step(struct sf_charger *c, const struct sf_power_input *in,
                    uint32_t now);
void sf_charger_stop(struct sf_charger *c);
int sf_cc_read(const struct sf_bus *bus, struct sf_power_input *in);

struct sf_ppg_word { uint32_t value; uint8_t tag; bool saturated; };
int sf_ppg_init(const struct sf_bus *bus);
int sf_ppg_read(const struct sf_bus *bus, struct sf_ppg_word *out, size_t cap,
                size_t *count, bool *gap);

struct sf_sample { int16_t a[3], g[3]; uint32_t time_ms; uint16_t flags; };
struct sf_fall {
    struct sf_sample history[SF_HISTORY_SIZE];
    float magnitude[SF_HISTORY_SIZE];
    size_t pos, count;
    double sum, sum2;
    float baseline[3], gravity[3], peak_g, last_z;
    uint32_t last_time, impact_time, still_time;
    bool pending, still;
};
void sf_fall_reset(struct sf_fall *f);
enum sf_event sf_fall_push(struct sf_fall *f, const struct sf_sample *sample);
size_t sf_fall_history(const struct sf_fall *f, struct sf_sample *out, size_t cap);
#endif
```

## include/sf_imu.h
```c
/* SPDX-License-Identifier: MIT */
#ifndef SF_IMU_H
#define SF_IMU_H
#include "sf_core.h"
#include "bmi270.h"
struct sf_imu { struct bmi2_dev dev; struct sf_bus bus; bool gyro; };
int sf_imu_init(struct sf_imu *imu, const struct sf_bus *bus, bool gyro);
/* Put an already-powered BMI270 into suspend, including after an MCU-only reset.
 * Does not upload the Bosch configuration image or start acquisition. */
int sf_imu_shutdown(const struct sf_bus *bus);
int sf_imu_read(struct sf_imu *imu, struct sf_sample *out, size_t cap,
                size_t *count, uint32_t now);
#endif
```

## include/sf_platform.h
```c
/* SPDX-License-Identifier: MIT */
#ifndef SF_PLATFORM_H
#define SF_PLATFORM_H
#include "sf_core.h"
#include "sf_rx.h"
#include <zephyr/device.h>
#include <zephyr/kernel.h>
extern struct k_sem sf_wake;
int sf_board_init(struct sf_bus *bus);
void sf_charge_gate(void *ctx, bool enabled);
int sf_ppg_power(bool enabled);
void sf_led(bool enabled);
int sf_battery_mv(void);
int sf_read_inputs(struct sf_power_input *input);
bool sf_take_power_change(void);
int sf_button_pressed(void);
int sf_watchdog_start(void);
int sf_watchdog_feed(void);
const struct device *sf_uart_device(void);
int sf_uart_enable(bool enabled);
int sf_uart_write(const uint8_t *bytes, size_t length);

void sf_rx_enqueue(enum sf_transport transport, const uint8_t *bytes, size_t len);
bool sf_rx_pop(struct sf_rx_chunk *chunk);
int sf_transport_init(void);
int sf_transport_send(enum sf_transport transport, const struct sf_packet *packet);
bool sf_ble_ready(void);
uint32_t sf_rx_drops(void);
uint32_t sf_tx_drops(void);
#endif
```

## include/sf_rx.h
```c
/* SPDX-License-Identifier: MIT */
#ifndef SF_RX_H
#define SF_RX_H
#include "sf_core.h"

/* At 115200 8N1 USB holds ~355ms of a continuous byte stream. This is
 * bounded buffering, not a guarantee against an indefinitely stalled main. */
#define SF_RX_USB_CAPACITY 4096u
#define SF_RX_BLE_CAPACITY 1024u

struct sf_rx_chunk {
    enum sf_transport transport;
    uint8_t length;
    bool gap; /* Reset this transport's parser BEFORE bytes, even if length=0. */
    uint8_t bytes[SF_FRAME_MAX];
};
struct sf_rx_lane { size_t head, size; bool gap; };
struct sf_rx_buffer {
    struct sf_rx_lane usb, ble;
    uint8_t usb_bytes[SF_RX_USB_CAPACITY], ble_bytes[SF_RX_BLE_CAPACITY];
    bool prefer_ble;
    uint32_t dropped_bytes, gaps; /* saturate instead of wrapping to zero */
};

/* A zero-initialized buffer is ready to use. The production wrapper MUST
 * serialize every operation (including counters) with its ISR-safe spinlock.
 * Enqueue copies bytes; pop copies owned output. No caller pointer is retained. */
bool sf_rx_buffer_enqueue(struct sf_rx_buffer *q, enum sf_transport src,
                          const uint8_t *bytes, size_t length);
bool sf_rx_buffer_pop(struct sf_rx_buffer *q, struct sf_rx_chunk *out);
/* Drop pending bytes for one transport, count them + known lost bytes, and
 * emit a gap before subsequently retained data. Other transport is untouched.
 * Hardware error losses may be unknown: the wrapper counts at least one. */
void sf_rx_buffer_gap(struct sf_rx_buffer *q, enum sf_transport src, size_t lost);
/* Production ISR-safe wrapper: discard queued bytes and reset the parser at
 * a link lifecycle boundary. The zero-length gap is observable immediately. */
void sf_rx_reset(enum sf_transport src);
#endif
```

## src/platform.c
```c
/* SPDX-License-Identifier: MIT */
#include "sf_platform.h"
#include <zephyr/drivers/adc.h>
#include <zephyr/drivers/gpio.h>
#include <zephyr/drivers/i2c.h>
#include <zephyr/drivers/uart.h>
#include <zephyr/drivers/watchdog.h>
#include <zephyr/pm/device.h>
#include <zephyr/sys/atomic.h>
#include <zephyr/irq.h>
#include <errno.h>

#define CTRL DT_NODELABEL(sf_control)
#define PIN(name, prop) static const struct gpio_dt_spec name=GPIO_DT_SPEC_GET(CTRL,prop)
PIN(charge_arm,charge_arm_gpios); PIN(ppg_en,ppg_enable_gpios);
PIN(led,led_gpios); PIN(motor,motor_gpios);
PIN(bat_en,battery_enable_gpios); PIN(uart_en,uart_enable_gpios);
PIN(usb_pg,usb_pg_gpios); PIN(suspend,suspend_gpios);
PIN(imu_int,imu_int_gpios); PIN(ppg_int,ppg_int_gpios);
PIN(button,button_gpios); PIN(bc_open,bc_open_gpios);
PIN(bc_allow,bc_allow_gpios); PIN(bc_high,bc_high_gpios);
PIN(chg_int,chg_int_gpios);
static const struct device *const i2c=DEVICE_DT_GET(DT_NODELABEL(i2c21));
static const struct device *const uart=DEVICE_DT_GET(DT_NODELABEL(uart20));
static const struct device *const wdt=DEVICE_DT_GET(DT_ALIAS(watchdog0));
static const struct adc_dt_spec battery=ADC_DT_SPEC_GET(CTRL);
static struct gpio_callback callbacks[6];
static atomic_t power_changed;
static atomic_t uart_on;
static int watchdog_channel=-1;
K_SEM_DEFINE(sf_wake,0,1);
K_MUTEX_DEFINE(uart_lock);

static void input_irq(const struct device *port, struct gpio_callback *cb, uint32_t pins) {
    ARG_UNUSED(cb);
    if ((port==usb_pg.port&&(pins&BIT(usb_pg.pin)))||
        (port==suspend.port&&(pins&BIT(suspend.pin)))) {
        /* Revoke charge immediately; the main thread then writes CHG_DIS.
         * No I2C, BLE, ADC or parsing is performed in an ISR. */
        (void)gpio_pin_set_dt(&charge_arm,0);
        atomic_set(&power_changed,1);
    }
    k_sem_give(&sf_wake);
}
static int bus_read(void *ctx, uint8_t addr, uint8_t reg, uint8_t *buf, size_t n) {
    ARG_UNUSED(ctx); return i2c_burst_read(i2c,addr,reg,buf,n);
}
static int bus_write(void *ctx, uint8_t addr, uint8_t reg, const uint8_t *buf, size_t n) {
    ARG_UNUSED(ctx); return i2c_burst_write(i2c,addr,reg,buf,n);
}
static void bus_delay(void *ctx, uint32_t ms) { ARG_UNUSED(ctx); k_msleep((int32_t)ms); }
int sf_board_init(struct sf_bus *bus) {
    const struct gpio_dt_spec *outputs[]={&charge_arm,&ppg_en,&motor,&led,&bat_en,&uart_en};
    const struct gpio_dt_spec *inputs[]={&usb_pg,&suspend,&imu_int,&ppg_int,&button,
                                        &bc_open,&bc_allow,&bc_high,&chg_int};
    for (size_t i=0;i<ARRAY_SIZE(outputs);i++) {
        if (!gpio_is_ready_dt(outputs[i])) return -ENODEV;
        int err=gpio_pin_configure_dt(outputs[i],GPIO_OUTPUT_INACTIVE);
        if (err) return err;
    }
    for (size_t i=0;i<ARRAY_SIZE(inputs);i++) {
        if (!gpio_is_ready_dt(inputs[i])) return -ENODEV;
        int err=gpio_pin_configure_dt(inputs[i],GPIO_INPUT);
        if (err) return err;
    }
    const struct gpio_dt_spec *irq[]={&usb_pg,&suspend,&imu_int,&ppg_int,&button,&chg_int};
    for (size_t i=0;i<ARRAY_SIZE(irq);i++) {
        /* Leave disabled sensor pins as inputs without wake interrupts. */
        if ((i==2&&!IS_ENABLED(CONFIG_SF_IMU))||(i==3&&!IS_ENABLED(CONFIG_SF_PPG))) {
            int err=gpio_pin_interrupt_configure_dt(irq[i],GPIO_INT_DISABLE);
            if (err) return err;
            continue;
        }
        gpio_init_callback(callbacks+i,input_irq,BIT(irq[i]->pin));
        int err=gpio_add_callback(irq[i]->port,callbacks+i);
        if (!err) err=gpio_pin_interrupt_configure_dt(irq[i],
            (i==0||i==1||i==4)?GPIO_INT_EDGE_BOTH:GPIO_INT_EDGE_TO_ACTIVE);
        if (err) return err;
    }
    if (!device_is_ready(i2c)||!adc_is_ready_dt(&battery)||!device_is_ready(uart)) return -ENODEV;
    int err=adc_channel_setup_dt(&battery);
    if (err) return err;
    uart_irq_rx_disable(uart);
    uart_irq_err_disable(uart);
    err=pm_device_action_run(uart,PM_DEVICE_ACTION_SUSPEND);
    if (err&&err!=-EALREADY) return err;
    *bus=(struct sf_bus){.read=bus_read,.write=bus_write,.delay_ms=bus_delay};
    return 0;
}
void sf_charge_gate(void *ctx, bool enabled) {
    ARG_UNUSED(ctx);
    enabled=enabled&&IS_ENABLED(CONFIG_SF_CHARGING)&&IS_ENABLED(CONFIG_SF_PACK_APPROVED);
    /* A USB/suspend interrupt may have revoked permission during I2C readback.
     * Serialize the pending check and GPIO write against that local ISR. */
    unsigned int key=irq_lock();
    if (atomic_get(&power_changed)) enabled=false;
    (void)gpio_pin_set_dt(&charge_arm,enabled);
    irq_unlock(key);
}
int sf_ppg_power(bool enabled) {
    return gpio_pin_set_dt(&ppg_en,enabled&&IS_ENABLED(CONFIG_SF_PPG));
}
void sf_led(bool enabled) { (void)gpio_pin_set_dt(&led,enabled); }
int sf_button_pressed(void) { return gpio_pin_get_dt(&button); }
bool sf_take_power_change(void) { return atomic_set(&power_changed,0)!=0; }
int sf_battery_mv(void) {
    int err=gpio_pin_set_dt(&bat_en,1);
    int32_t mv=-1;
    int16_t raw=0;
    static bool calibrated;
    if (!err) {
        k_msleep(5);
        struct adc_sequence seq={.buffer=&raw,.buffer_size=sizeof(raw),.calibrate=!calibrated};
        err=adc_sequence_init_dt(&battery,&seq);
        if (!err) err=adc_read(battery.dev,&seq);
        if (!err) {
            calibrated=true; mv=raw;
            err=adc_raw_to_millivolts_dt(&battery,&mv);
            if (!err&&(raw<0||mv<0)) err=-ERANGE;
        }
    }
    int off=gpio_pin_set_dt(&bat_en,0); /* unconditional, including conversion errors */
    if (err||off) return -1;
    return (int)((mv*147+23)/47);
}
int sf_read_inputs(struct sf_power_input *p) {
    int pg=gpio_pin_get_dt(&usb_pg), s=gpio_pin_get_dt(&suspend);
    int a=gpio_pin_get_dt(&bc_allow), h=gpio_pin_get_dt(&bc_high), o=gpio_pin_get_dt(&bc_open);
    if (pg<0||s<0||a<0||h<0||o<0) {
        p->present=false; p->cc_valid=false; sf_charge_gate(NULL,false);
        atomic_set(&power_changed,1); k_sem_give(&sf_wake); return -EIO;
    }
    p->present=pg!=0; p->awake=s==0; p->allow=a!=0; p->high=h!=0; p->switch_open=o!=0;
    return 0;
}
int sf_watchdog_start(void) {
    if (!device_is_ready(wdt)) return -ENODEV;
    struct wdt_timeout_cfg cfg={.window={.min=0,.max=6000},.flags=WDT_FLAG_RESET_SOC};
    watchdog_channel=wdt_install_timeout(wdt,&cfg);
    if (watchdog_channel<0) return watchdog_channel;
    return wdt_setup(wdt,WDT_OPT_PAUSE_HALTED_BY_DBG);
}
int sf_watchdog_feed(void) {
    return watchdog_channel<0?-ENODEV:wdt_feed(wdt,watchdog_channel);
}
const struct device *sf_uart_device(void) { return uart; }
static int uart_enable_locked(bool enabled) {
    if (enabled==(atomic_get(&uart_on)!=0)) return 0;
    if (!enabled) {
        (void)gpio_pin_set_dt(&uart_en,0);
        uart_irq_rx_disable(uart); uart_irq_err_disable(uart); atomic_set(&uart_on,0);
        int err=pm_device_action_run(uart,PM_DEVICE_ACTION_SUSPEND);
        return err==-EALREADY?0:err;
    }
    int err=pm_device_action_run(uart,PM_DEVICE_ACTION_RESUME);
    if (err&&err!=-EALREADY) return err;
    err=gpio_pin_set_dt(&uart_en,1);
    if (err) return err;
    atomic_set(&uart_on,1); uart_irq_err_enable(uart); uart_irq_rx_enable(uart); return 0;
}
int sf_uart_enable(bool enabled) {
    k_mutex_lock(&uart_lock,K_FOREVER);
    int err=uart_enable_locked(enabled);
    k_mutex_unlock(&uart_lock); return err;
}
int sf_uart_write(const uint8_t *bytes, size_t length) {
    k_mutex_lock(&uart_lock,K_FOREVER);
    int err=atomic_get(&uart_on)?0:-ENOTCONN;
    if (!err) for (size_t i=0;i<length;i++) uart_poll_out(uart,bytes[i]);
    k_mutex_unlock(&uart_lock); return err;
}
```

## src/transport.c
```c
/* SPDX-License-Identifier: MIT */
#include "sf_platform.h"
#include "sf_rx.h"
#include <zephyr/bluetooth/bluetooth.h>
#include <zephyr/bluetooth/conn.h>
#include <zephyr/bluetooth/gatt.h>
#include <zephyr/drivers/uart.h>
#include <zephyr/settings/settings.h>
#include <zephyr/sys/atomic.h>
#include <zephyr/logging/log.h>
#include <errno.h>
#include <string.h>
LOG_MODULE_REGISTER(sf_transport,LOG_LEVEL_INF);
#define UUID(n) BT_UUID_128_ENCODE(0x0f54f000u+(n),0xe1b4,0x47d4,0xbded,0x55c810ec9020)
static struct bt_uuid_128 service_uuid=BT_UUID_INIT_128(UUID(1));
static struct bt_uuid_128 tx_uuid=BT_UUID_INIT_128(UUID(2));
static struct bt_uuid_128 rx_uuid=BT_UUID_INIT_128(UUID(3));
static struct bt_conn *peer;
K_MUTEX_DEFINE(peer_lock);
static atomic_t subscribed, encrypted, tx_dropped;
static struct sf_rx_buffer rxq;
static struct k_spinlock rx_lock;
struct tx_item { enum sf_transport transport; uint16_t length; uint8_t bytes[SF_FRAME_MAX]; };
K_MSGQ_DEFINE(txq,sizeof(struct tx_item),16,4);
void sf_rx_enqueue(enum sf_transport src, const uint8_t *bytes, size_t len) {
    k_spinlock_key_t key=k_spin_lock(&rx_lock);
    (void)sf_rx_buffer_enqueue(&rxq,src,bytes,len);
    k_spin_unlock(&rx_lock,key);
    k_sem_give(&sf_wake);
}
static void rx_gap(enum sf_transport src, size_t lost) {
    k_spinlock_key_t key=k_spin_lock(&rx_lock);
    sf_rx_buffer_gap(&rxq,src,lost);
    k_spin_unlock(&rx_lock,key);
    k_sem_give(&sf_wake);
}
void sf_rx_reset(enum sf_transport src) { rx_gap(src,0); }
bool sf_rx_pop(struct sf_rx_chunk *c) {
    k_spinlock_key_t key=k_spin_lock(&rx_lock);
    bool found=sf_rx_buffer_pop(&rxq,c);
    k_spin_unlock(&rx_lock,key); return found;
}
uint32_t sf_rx_drops(void) {
    k_spinlock_key_t key=k_spin_lock(&rx_lock);
    uint32_t lost=rxq.dropped_bytes;
    k_spin_unlock(&rx_lock,key); return lost;
}
uint32_t sf_tx_drops(void) { return (uint32_t)atomic_get(&tx_dropped); }
static void ccc_changed(const struct bt_gatt_attr *attr, uint16_t value) {
    ARG_UNUSED(attr); atomic_set(&subscribed,value==BT_GATT_CCC_NOTIFY); k_sem_give(&sf_wake);
}
static ssize_t rx_write(struct bt_conn *conn, const struct bt_gatt_attr *attr,
                        const void *data, uint16_t len, uint16_t offset, uint8_t flags) {
    ARG_UNUSED(attr);
    if (offset||flags&BT_GATT_WRITE_FLAG_PREPARE) return BT_GATT_ERR(BT_ATT_ERR_INVALID_OFFSET);
    if (len>SF_FRAME_MAX) return BT_GATT_ERR(BT_ATT_ERR_INVALID_ATTRIBUTE_LEN);
    if (bt_conn_get_security(conn)<BT_SECURITY_L2) return BT_GATT_ERR(BT_ATT_ERR_AUTHENTICATION);
    sf_rx_enqueue(SF_BLE,data,len); return len;
}
BT_GATT_SERVICE_DEFINE(sf_service,
    BT_GATT_PRIMARY_SERVICE(&service_uuid),
    BT_GATT_CHARACTERISTIC(&tx_uuid.uuid,BT_GATT_CHRC_NOTIFY,0,NULL,NULL,NULL),
    BT_GATT_CCC(ccc_changed,BT_GATT_PERM_READ_ENCRYPT|BT_GATT_PERM_WRITE_ENCRYPT),
    BT_GATT_CHARACTERISTIC(&rx_uuid.uuid,BT_GATT_CHRC_WRITE|BT_GATT_CHRC_WRITE_WITHOUT_RESP,
                           BT_GATT_PERM_WRITE_ENCRYPT,NULL,rx_write,NULL));
static const struct bt_data advertising[]={
    BT_DATA_BYTES(BT_DATA_FLAGS,BT_LE_AD_GENERAL|BT_LE_AD_NO_BREDR),
    BT_DATA_BYTES(BT_DATA_UUID128_ALL,UUID(1))};
static const struct bt_data scan_response[]={
    BT_DATA(BT_DATA_NAME_COMPLETE,CONFIG_BT_DEVICE_NAME,sizeof(CONFIG_BT_DEVICE_NAME)-1)};
static void advertise(struct k_work *work);
K_WORK_DELAYABLE_DEFINE(adv_work,advertise);
static void advertise(struct k_work *work) {
    ARG_UNUSED(work);
    int err=bt_le_adv_start(BT_LE_ADV_PARAM(BT_LE_ADV_OPT_CONN,800,1600,NULL),
         advertising,ARRAY_SIZE(advertising),scan_response,ARRAY_SIZE(scan_response));
    if (err&&err!=-EALREADY) {
        LOG_WRN("Advertising retry: %d",err); k_work_reschedule(&adv_work,K_SECONDS(1));
    }
}
static void connected(struct bt_conn *c, uint8_t err) {
    if (err) { k_work_reschedule(&adv_work,K_MSEC(500)); return; }
    k_mutex_lock(&peer_lock,K_FOREVER); peer=bt_conn_ref(c); k_mutex_unlock(&peer_lock);
    atomic_set(&encrypted,0); atomic_set(&subscribed,0); rx_gap(SF_BLE,0);
    int rc=bt_conn_set_security(c,BT_SECURITY_L2);
    if (rc) LOG_WRN("Pairing/security request: %d",rc);
    k_sem_give(&sf_wake);
}
static void disconnected(struct bt_conn *c, uint8_t reason) {
    ARG_UNUSED(reason);
    atomic_set(&encrypted,0); atomic_set(&subscribed,0); rx_gap(SF_BLE,0);
    k_mutex_lock(&peer_lock,K_FOREVER);
    if (peer==c) { bt_conn_unref(peer); peer=NULL; }
    k_mutex_unlock(&peer_lock);
    k_work_reschedule(&adv_work,K_MSEC(500)); k_sem_give(&sf_wake);
}
static void security_changed(struct bt_conn *c, bt_security_t level, enum bt_security_err err) {
    ARG_UNUSED(c); atomic_set(&encrypted,!err&&level>=BT_SECURITY_L2); k_sem_give(&sf_wake);
}
BT_CONN_CB_DEFINE(connection_callbacks)={.connected=connected,.disconnected=disconnected,
                                        .security_changed=security_changed};
bool sf_ble_ready(void) { return atomic_get(&subscribed)&&atomic_get(&encrypted); }
static void uart_irq(const struct device *dev, void *data) {
    ARG_UNUSED(data);
    if (!uart_irq_update(dev)) return;
    /* ERRORSRC survives the Nordic ISR's EVENT_ERROR clear. The exact number
     * of bytes lost to a hardware overrun is unknown: count at least one and
     * force parser resynchronization instead of joining across that gap. */
    if (uart_err_check(dev)) rx_gap(SF_USB,1);
    while (uart_irq_rx_ready(dev)) {
        uint8_t bytes[32]; int n=uart_fifo_read(dev,bytes,sizeof(bytes));
        if (n<=0) break;
        sf_rx_enqueue(SF_USB,bytes,(size_t)n);
    }
}
int sf_transport_send(enum sf_transport transport, const struct sf_packet *packet) {
    if (transport!=SF_USB&&transport!=SF_BLE) return -ENOTCONN;
    struct tx_item tx={.transport=transport};
    tx.length=(uint16_t)sf_encode(packet,tx.bytes,sizeof(tx.bytes));
    if (!tx.length) return -EINVAL;
    int err=k_msgq_put(&txq,&tx,K_NO_WAIT);
    if (err) atomic_inc(&tx_dropped);
    return err;
}
static int send_ble(const struct tx_item *tx) {
    if (!sf_ble_ready()) return -ENOTCONN;
    k_mutex_lock(&peer_lock,K_FOREVER);
    struct bt_conn *c=peer?bt_conn_ref(peer):NULL;
    k_mutex_unlock(&peer_lock);
    if (!c) return -ENOTCONN;
    int err=0;
    /* Always use <=20-byte fragments: even the default ATT MTU=23 works.
     * The host reconstructs the exact same CRC-protected byte stream as UART. */
    for (size_t at=0;at<tx->length&&!err;at+=20) {
        size_t n=tx->length-at; if (n>20) n=20;
        err=bt_gatt_notify(c,&sf_service.attrs[2],tx->bytes+at,(uint16_t)n);
    }
    bt_conn_unref(c); return err;
}
static void tx_worker(void *a, void *b, void *c) {
    ARG_UNUSED(a); ARG_UNUSED(b); ARG_UNUSED(c);
    struct tx_item tx;
    while (true) {
        k_msgq_get(&txq,&tx,K_FOREVER);
        int err=0;
        if (tx.transport==SF_BLE) err=send_ble(&tx);
        else {
            struct sf_power_input power={0};
            err=sf_read_inputs(&power);
            if (!err&&(!power.present||!power.awake||power.switch_open)) err=-ENOTCONN;
            if (!err) err=sf_uart_write(tx.bytes,tx.length);
        }
        if (err) atomic_inc(&tx_dropped);
    }
}
K_THREAD_DEFINE(tx_thread,3072,tx_worker,NULL,NULL,NULL,7,0,0);
int sf_transport_init(void) {
    int err=uart_irq_callback_user_data_set(sf_uart_device(),uart_irq,NULL);
    if (err) return err;
    err=bt_enable(NULL);
    if (!err) err=settings_load();
    if (!err) k_work_reschedule(&adv_work,K_NO_WAIT);
    return err;
}
```
